## Edge/esp-idf-projects/smart_irrigation_system/main/Kconfig.projbuild
```kconfig
menu "Smart Irrigation System Configuration"

    config WIFI_SSID
        string "WiFi SSID"
        default "MyWiFiNetwork"
        help
            SSID (network name) for the WiFi network to connect to.

    config WIFI_PASSWORD
        string "WiFi Password"
        default "MyWiFiPassword"
        help
            WiFi password (WPA or WPA2) for the WiFi network.

    config MQTT_BROKER_URL
        string "MQTT Broker URL"
        default "mqtt://test.mosquitto.org:1883"
        help
            URL of the MQTT broker to connect to.

    config MQTT_USERNAME
        string "MQTT Username"
        default ""
        help
            Username for MQTT broker authentication (leave empty if not required).

    config MQTT_PASSWORD
        string "MQTT Password"
        default ""
        help
            Password for MQTT broker authentication (leave empty if not required).

    config DEVICE_ID
        string "Device ID"
        default "smart_irrigation_001"
        help
            Unique identifier for this device.

    config SOIL_MOISTURE_THRESHOLD
        int "Soil Moisture Threshold (%)"
        range 0 100
        default 30
        help
            Soil moisture threshold below which irrigation will be triggered.

    config IRRIGATION_DURATION
        int "Irrigation Duration (seconds)"
        range 1 3600
        default 300
        help
            Duration for which irrigation will run when triggered.

    config SENSOR_READ_INTERVAL
        int "Sensor Read Interval (seconds)"
        range 1 3600
        default 30
        help
            Interval between sensor readings.

endmenu
```

## Edge/esp-idf-projects/smart_irrigation_system/sdkconfig.defaults
```kconfig
# ESP32 Configuration
CONFIG_IDF_TARGET_ESP32=y
CONFIG_IDF_TARGET="esp32"

# Wi-Fi Configuration
CONFIG_ESP32_WIFI_ENABLED=y
CONFIG_ESP32_WIFI_STATIC_RX_BUFFER_NUM=10
CONFIG_ESP32_WIFI_DYNAMIC_RX_BUFFER_NUM=32
CONFIG_ESP32_WIFI_TX_BUFFER_TYPE=1
CONFIG_ESP32_WIFI_DYNAMIC_TX_BUFFER_NUM=32
CONFIG_ESP32_WIFI_AMPDU_TX_ENABLED=y
CONFIG_ESP32_WIFI_AMPDU_RX_ENABLED=y

# MQTT Configuration
CONFIG_MQTT_PROTOCOL_311=y
CONFIG_MQTT_TRANSPORT_SSL=y
CONFIG_MQTT_TRANSPORT_WEBSOCKET=y
CONFIG_MQTT_TRANSPORT_WEBSOCKET_SECURE=y

# FreeRTOS Configuration
CONFIG_FREERTOS_HZ=1000
CONFIG_FREERTOS_ASSERT_ON_UNTESTED_FUNCTION=y
CONFIG_FREERTOS_CHECK_STACKOVERFLOW_PTRVAL=y
CONFIG_FREERTOS_THREAD_LOCAL_STORAGE_POINTERS=1
CONFIG_FREERTOS_IDLE_TASK_STACKSIZE=1536
CONFIG_FREERTOS_ISR_STACKSIZE=1536
CONFIG_FREERTOS_LEGACY_HOOKS=y
CONFIG_FREERTOS_MAX_TASK_NAME_LEN=16
CONFIG_FREERTOS_SUPPORT_STATIC_ALLOCATION=y
CONFIG_FREERTOS_TIMER_TASK_PRIORITY=1
CONFIG_FREERTOS_TIMER_TASK_STACK_DEPTH=2048
CONFIG_FREERTOS_TIMER_QUEUE_LENGTH=10
CONFIG_FREERTOS_QUEUE_REGISTRY_SIZE=0

# Log Configuration
CONFIG_LOG_DEFAULT_LEVEL_INFO=y
CONFIG_LOG_DEFAULT_LEVEL=3
CONFIG_LOG_MAXIMUM_EQUALS_DEFAULT=y
CONFIG_LOG_MAXIMUM_LEVEL=3
CONFIG_LOG_COLORS=y
CONFIG_LOG_TIMESTAMP_SOURCE_RTOS=y

# ESP System Configuration
CONFIG_ESP_SYSTEM_EVENT_QUEUE_SIZE=32
CONFIG_ESP_SYSTEM_EVENT_TASK_STACK_SIZE=2304
CONFIG_ESP_MAIN_TASK_STACK_SIZE=3584
CONFIG_ESP_MAIN_TASK_AFFINITY_CPU0=y
CONFIG_ESP_MAIN_TASK_AFFINITY=0x0
CONFIG_ESP_MINIMAL_SHARED_STACK_SIZE=2048
CONFIG_ESP_CONSOLE_UART_DEFAULT=y
CONFIG_ESP_CONSOLE_UART=y
CONFIG_ESP_CONSOLE_UART_NUM=0
CONFIG_ESP_CONSOLE_UART_BAUDRATE=115200

# Partition Table
CONFIG_PARTITION_TABLE_CUSTOM=y
CONFIG_PARTITION_TABLE_CUSTOM_FILENAME="partitions.csv"
CONFIG_PARTITION_TABLE_FILENAME="partitions.csv"

# ADC Configuration
CONFIG_ADC_CAL_EFUSE_TP_ENABLE=y
CONFIG_ADC_CAL_EFUSE_VREF_ENABLE=y
CONFIG_ADC_CAL_LUT_ENABLE=y
```

## Edge/smart_irrigation_esp32/main/Kconfig.projbuild
```kconfig
menu "Smart Irrigation System Configuration"

    config SMART_IRRIGATION_WIFI_SSID
        string "WiFi SSID"
        default "YOUR_WIFI_SSID"
        help
            SSID (network name) for the WiFi connection.

    config SMART_IRRIGATION_WIFI_PASSWORD
        string "WiFi Password"
        default "YOUR_WIFI_PASSWORD"
        help
            Password for the WiFi connection.

    config SMART_IRRIGATION_MQTT_BROKER_URI
        string "MQTT Broker URI"
        default "mqtt://your-broker.com:1883"
        help
            URI of the MQTT broker to connect to.

    config SMART_IRRIGATION_MQTT_USERNAME
        string "MQTT Username"
        default "your_mqtt_user"
        help
            Username for MQTT authentication.

    config SMART_IRRIGATION_MQTT_PASSWORD
        string "MQTT Password"
        default "your_mqtt_password"
        help
            Password for MQTT authentication.

    config SMART_IRRIGATION_DEVICE_ID
        string "Device ID"
        default "irrigation_system_001"
        help
            Unique identifier for this irrigation system device.

    config SMART_IRRIGATION_MOISTURE_THRESHOLD
        int "Soil Moisture Threshold (%)"
        default 30
        range 10 90
        help
            Soil moisture percentage below which irrigation starts.

    config SMART_IRRIGATION_MAX_TIME_MINUTES
        int "Maximum Irrigation Time (minutes)"
        default 5
        range 1 60
        help
            Maximum time for a single irrigation cycle in minutes.

endmenu
```

## Node/esp-idf-node/sdkconfig.defaults
```kconfig
# Smart Irrigation Node - Default Configuration

# ESP32 Configuration
CONFIG_IDF_TARGET_ESP32=y
CONFIG_ESP32_DEFAULT_CPU_FREQ_240=y

# WiFi Configuration
CONFIG_ESP_WIFI_ENABLED=y
CONFIG_ESP_WIFI_STATIC_RX_BUFFER_NUM=10
CONFIG_ESP_WIFI_DYNAMIC_RX_BUFFER_NUM=32
CONFIG_ESP_WIFI_TX_BUFFER_TYPE=1
CONFIG_ESP_WIFI_DYNAMIC_TX_BUFFER_NUM=32
CONFIG_ESP_WIFI_AMPDU_TX_ENABLED=y
CONFIG_ESP_WIFI_AMPDU_RX_ENABLED=y

# FreeRTOS Configuration
CONFIG_FREERTOS_UNICORE=n
CONFIG_FREERTOS_HZ=1000

# Log Configuration
CONFIG_LOG_DEFAULT_LEVEL_INFO=y
CONFIG_LOG_MAXIMUM_LEVEL_DEBUG=y

# SPI Configuration
CONFIG_SPI_FLASH_SIZE_2MB=y

# ADC Configuration
CONFIG_ADC_ONESHOT_CTRL_FUNC_IN_IRAM=y

# GPIO Configuration
CONFIG_GPIO_ESP32_SUPPORT_SWITCH_SLP_PULL=y

# Partition Table
CONFIG_PARTITION_TABLE_SINGLE_APP=y

# Application Configuration
CONFIG_APP_COMPILE_TIME_DATE=y
CONFIG_APP_EXCLUDE_PROJECT_VER_VAR=n
CONFIG_APP_EXCLUDE_PROJECT_NAME_VAR=n

# Network Configuration
CONFIG_LWIP_IPV6=y
CONFIG_LWIP_IPV4=y

# Security Configuration
CONFIG_SECURE_BOOT_ENABLED=n
CONFIG_SECURE_FLASH_ENC_ENABLED=n
```

## examples/esp-idf-template/sdkconfig.defaults
```kconfig
# ESP32 Default Configuration for Smart Irrigation System

# Compiler options
CONFIG_COMPILER_OPTIMIZATION_SIZE=y
CONFIG_COMPILER_OPTIMIZATION_ASSERTIONS_SILENT=y

# Flash settings
CONFIG_ESPTOOLPY_FLASHMODE_DIO=y
CONFIG_ESPTOOLPY_FLASHFREQ_80M=y
CONFIG_ESPTOOLPY_FLASHSIZE_4MB=y
CONFIG_PARTITION_TABLE_CUSTOM=y
CONFIG_PARTITION_TABLE_CUSTOM_FILENAME="partitions.csv"

# WiFi settings
CONFIG_ESP32_WIFI_STATIC_RX_BUFFER_NUM=8
CONFIG_ESP32_WIFI_DYNAMIC_RX_BUFFER_NUM=16
CONFIG_ESP32_WIFI_STATIC_TX_BUFFER_NUM=8
CONFIG_ESP32_WIFI_DYNAMIC_TX_BUFFER_NUM=16
CONFIG_ESP32_WIFI_AMPDU_TX_ENABLED=y
CONFIG_ESP32_WIFI_AMPDU_RX_ENABLED=y

# Bluetooth (disable to save memory)
CONFIG_BT_ENABLED=n

# FreeRTOS settings
CONFIG_FREERTOS_HZ=1000
CONFIG_FREERTOS_ENABLE_STATIC_TASK_CLEAN_UP=y
CONFIG_FREERTOS_TIMER_TASK_PRIORITY=1
CONFIG_FREERTOS_TIMER_TASK_STACK_DEPTH=2048
CONFIG_FREERTOS_TIMER_QUEUE_LENGTH=10

# Log settings
CONFIG_LOG_DEFAULT_LEVEL_INFO=y
CONFIG_LOG_MAXIMUM_LEVEL_DEBUG=y
CONFIG_LOG_COLORS=y
CONFIG_LOG_TIMESTAMP_SOURCE_RTOS=y

# LWIP settings
CONFIG_LWIP_MAX_SOCKETS=16
CONFIG_LWIP_SO_REUSE=y
CONFIG_LWIP_SO_REUSE_RXTOALL=y
CONFIG_LWIP_IP_REASS_MAX_PBUFS=20
CONFIG_LWIP_IP_SOF_BROADCAST=y
CONFIG_LWIP_IP_SOF_BROADCAST_RECV=y

# HTTP Client settings
CONFIG_ESP_HTTP_CLIENT_ENABLE_HTTPS=y
CONFIG_ESP_HTTP_CLIENT_ENABLE_BASIC_AUTH=y
CONFIG_ESP_HTTP_CLIENT_ENABLE_DIGEST_AUTH=y

# MQTT settings
CONFIG_MQTT_PROTOCOL_311=y
CONFIG_MQTT_TRANSPORT_SSL=y
CONFIG_MQTT_TRANSPORT_WEBSOCKET=y
CONFIG_MQTT_TRANSPORT_WEBSOCKET_SECURE=y

# mbedTLS settings
CONFIG_MBEDTLS_CERTIFICATE_BUNDLE=y
CONFIG_MBEDTLS_CERTIFICATE_BUNDLE_DEFAULT_FULL=y
CONFIG_MBEDTLS_SSL_PROTO_TLS1_2=y
CONFIG_MBEDTLS_SSL_PROTO_DTLS=y
CONFIG_MBEDTLS_KEY_EXCHANGE_RSA=y
CONFIG_MBEDTLS_KEY_EXCHANGE_DHE_RSA=y
CONFIG_MBEDTLS_KEY_EXCHANGE_ECDHE_RSA=y
CONFIG_MBEDTLS_KEY_EXCHANGE_ECDHE_ECDSA=y
CONFIG_MBEDTLS_KEY_EXCHANGE_ECDH_ECDSA=y
CONFIG_MBEDTLS_KEY_EXCHANGE_ECDH_RSA=y

# NVS settings
CONFIG_NVS_ENCRYPTION=y

# Power management
CONFIG_PM_ENABLE=y
CONFIG_PM_POWER_DOWN_CPU_IN_LIGHT_SLEEP=y
CONFIG_PM_POWER_DOWN_TAGMEM_IN_LIGHT_SLEEP=y

# ADC settings
CONFIG_ADC_DISABLE_DAC=y

# SPI settings
CONFIG_SPI_FLASH_WRITING_DANGEROUS_REGIONS_ABORTS=n

# Task watchdog
CONFIG_ESP_TASK_WDT=y
CONFIG_ESP_TASK_WDT_PANIC=y
CONFIG_ESP_TASK_WDT_TIMEOUT_S=10
CONFIG_ESP_TASK_WDT_CHECK_IDLE_TASK_CPU0=y
CONFIG_ESP_TASK_WDT_CHECK_IDLE_TASK_CPU1=y

# Interrupt watchdog
CONFIG_ESP_INT_WDT=y
CONFIG_ESP_INT_WDT_TIMEOUT_MS=300
CONFIG_ESP_INT_WDT_CHECK_CPU0=y
CONFIG_ESP_INT_WDT_CHECK_CPU1=y

# Application specific settings
CONFIG_SMART_IRRIGATION_SENSOR_INTERVAL=300
CONFIG_SMART_IRRIGATION_LORA_FREQUENCY=915000000
CONFIG_SMART_IRRIGATION_LORA_SF=7
CONFIG_SMART_IRRIGATION_LORA_BW=125000
CONFIG_SMART_IRRIGATION_LORA_TX_POWER=14
CONFIG_SMART_IRRIGATION_DEEP_SLEEP_DURATION=1800
```
